## Kconfig
```kconfig
#
# Copyright (C) 2023 Xiaomi Corporation
#
# Licensed under the Apache License, Version 2.0 (the "License");
# you may not use this file except in compliance with the License.
# You may obtain a copy of the License at
#
#      http://www.apache.org/licenses/LICENSE-2.0
#
# Unless required by applicable law or agreed to in writing, software
# distributed under the License is distributed on an "AS IS" BASIS,
# WITHOUT WARRANTIES OR CONDITIONS OF ANY KIND, either express or implied.
# See the License for the specific language governing permissions and
# limitations under the License.
#

config SYSTEM_PACKAGE_SERVICE
	bool "Enable package manager"
	default n
	depends on ANDROID_BINDER
	depends on SYSTEM_SERVER

if SYSTEM_PACKAGE_SERVICE

config SYSTEM_PACKAGE_SERVICE_COMMAND
	tristate "Enable package manager command tool"
	default n

config SYSTEM_PACKAGE_SERVICE_TEST
	bool "Enable package manager google test"
    default n
    depends on GOOGLE_TEST

endif
```
